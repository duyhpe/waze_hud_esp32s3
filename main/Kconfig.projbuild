## main/Kconfig.projbuild
```kconfig
menu "Waze HUD firmware"

choice WAZE_HUD_DISPLAY_PROFILE
    prompt "Display profile"
    default WAZE_HUD_DISPLAY_35_480X320

config WAZE_HUD_DISPLAY_TDISPLAY_S3
    bool "LILYGO T-Display S3 (320x170 landscape)"

config WAZE_HUD_DISPLAY_35_480X320
    bool "Generic 3.5-inch layout (480x320 landscape)"
    help
        Enables the 480x320 logical HUD layout and HLP display declaration.
        The panel controller and pin mapping must be supplied by the target BSP.

        Cho phép bố cục HUD logic 480x320 và khai báo hiển thị HLP. Bộ điều khiển bảng và ánh xạ chân phải được cung cấp bởi BSP mục tiêu.
        Bảng điều khiển và ánh xạ chân phải được cung cấp bởi BSP mục tiêu.

config WAZE_HUD_DISPLAY_40_480X320
    bool "Generic 4.0-inch layout (480x320 landscape)"
    help
        Sử dụng ESP32-S3 4.0" LCD (480x320 landscape) với các chân GPIO được định nghĩa trong BSP. 
        Kích thước hiển thị và bố cục logic HUD được xác định bởi cấu hình này.

endchoice

config WAZE_HUD_MOCK_MODE
    bool "Enable renderer mock mode"
    default n
    help
        Cycle deterministic renderer scenarios without requiring a phone.
        Minimum speed remains mock-only; lane guidance also exercises the
        real HLP/1 direction-mask representation.

        Thiết lập này cho phép mô phỏng dữ liệu của Waze HUD mà không cần kết nối với điện thoại và di chuyển xe ngoài thực tế.
        Tốc độ tối thiểu vẫn chỉ là mô phỏng; hướng dẫn làn đường cũng thực hiện đại diện mặt nạ hướng HLP/1 thực tế.  

config WAZE_HUD_DEFAULT_BRIGHTNESS
    int "Default backlight brightness (percent)"
    range 10 100
    default 100
    help
        Must align with the HLP configuration slider's 5 percent step.
        Cho phép căn chỉnh độ sáng đèn nền mặc định theo bước 5%.

config WAZE_HUD_HEADLESS_DIAGNOSTIC
    bool "Disable LCD/UI for watchdog isolation"
    default n
    help
        Keep BLE, HLP, state and configuration active while skipping display
        initialization and the UI task. Intended only for hardware diagnosis.

        Duy trì BLE, HLP, trạng thái và cấu hình hoạt động trong khi bỏ qua khởi tạo hiển thị và tác vụ UI. 
        Chỉ dành cho chẩn đoán phần cứng.   
        Cài đặt này sẽ vô hiệu hóa các tác vụ liên quan đến hiển thị và giao diện người dùng, giúp cô lập các vấn đề phần cứng mà không ảnh hưởng đến các chức năng BLE và HLP. 

config WAZE_HUD_UI_TASK_CORE
    int "UI task core"
    range 0 1
    default 1

endmenu
```
